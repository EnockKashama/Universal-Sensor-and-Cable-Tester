## sdkconfig.defaults
```kconfig
CONFIG_ESP32_ENABLE_COREDUMP_TO_FLASH=y
CONFIG_MEMFAULT_PROJECT_KEY="cQV92QXz87LxsqJw8yyZWqal8WDMCukp"
CONFIG_MEMFAULT_HTTP_PERIODIC_UPLOAD=y
CONFIG_PARTITION_TABLE_CUSTOM=y
CONFIG_PARTITION_TABLE_CUSTOM_FILENAME="partitions.csv"

CONFIG_ESPTOOLPY_FLASHSIZE_16MB=y
CONFIG_ESPTOOLPY_FLASHSIZE="16MB"

CONFIG_MEMFAULT_CLI_SELF_TEST=n
CONFIG_MEMFAULT_DEMO_CLI=n

CONFIG_MEMFAULT_ESP_TEMPERATURE_SENSOR=n

CONFIG_BOOTLOADER_COMPILER_OPTIMIZATION_PERF=y

CONFIG_MEMFAULT_HTTP_PERIODIC_UPLOAD_INTERVAL_SECS=60

CONFIG_MEMFAULT_DEVICE_INFO_SOFTWARE_VERSION="1.0.0"
CONFIG_MEMFAULT_DEVICE_INFO_SOFTWARE_TYPE="universal-cable-tester"
```
